## boards/shields/kbName/Kconfig.defconfig
```kconfig
# Required files for ZMK to recognize the shield

if BLANKV2

# Name must be less than 16 characters long!
config ZMK_KEYBOARD_NAME
    default "blankv2"

endif
```
